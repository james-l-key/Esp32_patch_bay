## main/Kconfig.projbuild
```kconfig
menu "Patch Bay Configuration"

    choice DISPLAY_TYPE
        prompt "Display Driver"
        default SSD1306
        help
            Select the OLED display driver.

        config SSD1306
            bool "SSD1306"
        config SH1106
            bool "SH1106"
    endchoice

    config I2C_SDA_PIN
        int "I2C SDA Pin"
        default 4
        range 0 48
        help
            GPIO pin for I2C SDA (display communication).

    config I2C_SCL_PIN
        int "I2C SCL Pin"
        default 5
        range 0 48
        help
            GPIO pin for I2C SCL (display communication).

    config PROGRAM_BUTTON_PIN
        int "Program Button Pin"
        default 14
        range 0 48
        help
            GPIO pin for Program button.

    config PRESET_BUTTON_PIN
        int "Preset Button Pin"
        default 15
        range 0 48
        help
            GPIO pin for Preset button.

    config PEDAL_BUTTON_1_PIN
        int "Pedal 1 Button Pin"
        default 6
        range 0 48
        help
            GPIO pin for Pedal 1 button.

    config PEDAL_BUTTON_2_PIN
        int "Pedal 2 Button Pin"
        default 7
        range 0 48
        help
            GPIO pin for Pedal 2 button.

    config PEDAL_BUTTON_3_PIN
        int "Pedal 3 Button Pin"
        default 8
        range 0 48
        help
            GPIO pin for Pedal 3 button.

    config PEDAL_BUTTON_4_PIN
        int "Pedal 4 Button Pin"
        default 9
        range 0 48
        help
            GPIO pin for Pedal 4 button.

    config PEDAL_BUTTON_5_PIN
        int "Pedal 5 Button Pin"
        default 10
        range 0 48
        help
            GPIO pin for Pedal 5 button.

    config PEDAL_BUTTON_6_PIN
        int "Pedal 6 Button Pin"
        default 11
        range 0 48
        help
            GPIO pin for Pedal 6 button.

    config PEDAL_BUTTON_7_PIN
        int "Pedal 7 Button Pin"
        default 12
        range 0 48
        help
            GPIO pin for Pedal 7 button.

    config PEDAL_BUTTON_8_PIN
        int "Pedal 8 Button Pin"
        default 13
        range 0 48
        help
            GPIO pin for Pedal 8 button.

    config MATRIX_SR_DATA_PIN
        int "Matrix Shift Register Data Pin (MATRIX_SR_DS)"
        default 16
        range 0 48
        help
            GPIO pin for 74HC595 shift register data.

    config SR_CLOCK_PIN
        int "Shift Register Clock Pin (SR_SHCP)"
        default 17
        range 0 48
        help
            GPIO pin for 74HC595 shift register clock.

    config SR_LATCH_PIN
        int "Shift Register Latch Pin (SR_STCP)"
        default 18
        range 0 48
        help
            GPIO pin for 74HC595 shift register latch.

    config SR_OUTPUT_ENABLE_PIN
        int "Shift Register Output Enable Pin (SR_OE)"
        default 19
        range 0 48
        help
            GPIO pin for 74HC595 shift register output enable.

    config ENABLE_LEDS
        bool "Enable LED Indicators"
        default n
        help
            Enable 8 LEDs for pedal status indicators.

    config LED_SR_DATA_PIN
        int "LED Shift Register Data Pin (LED_SR_DS)"
        default 21
        range 0 48
        depends on ENABLE_LEDS
        help
            GPIO pin for 74HC595 shift register data.

endmenu
```
